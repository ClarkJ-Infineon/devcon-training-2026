## CMakeLists.txt
```
# SPDX-License-Identifier: Apache-2.0
#
# DevCon 2026 PSOC Edge lab - Device Dashboard, cheat tier.
#
# Steps 2 and 3 of the lab each switch on a local module. This app consumes
# LVGL as a west module, and additionally builds two small local modules
# (modules/tilt_filter, modules/beeper) to show what the other side of the
# boundary looks like. ZEPHYR_EXTRA_MODULES is the mechanism, and it must be
# set *before* find_package(Zephyr).

cmake_minimum_required(VERSION 3.20.0)

list(APPEND ZEPHYR_EXTRA_MODULES ${CMAKE_CURRENT_SOURCE_DIR}/modules/tilt_filter)
list(APPEND ZEPHYR_EXTRA_MODULES ${CMAKE_CURRENT_SOURCE_DIR}/modules/beeper)

find_package(Zephyr REQUIRED HINTS $ENV{ZEPHYR_BASE})
project(e84_dashboard)

target_sources(app PRIVATE
	src/main.c
	src/ui.c
)
```

## prj.conf
```kconfig
# DevCon 2026 PSOC Edge lab - Device Dashboard, cheat tier.
#
# The display half of this file is inherited wholesale from the display
# bring-up configuration that was proven on hardware. Every symbol carries a
# comment explaining *why* it is needed, kept verbatim because attendees read
# this file during touchpoint 2.

# --- Display plumbing (proven) --------------------------------------------
#
# The infineon_dc display driver only supports whole-frame flushes (it swaps
# the entire frame buffer pointer rather than copying partial rects), so LVGL
# must be forced into full-refresh rendering mode.
#
# A full-frame RGB565 buffer at 832x480 is ~781 KB, which does not fit in the
# M55 core's system RAM region. Placing it in the "GFX_MEMORY"
# zephyr,memory-region (the gfx_mem node the board overlay adds in SOCMEM)
# avoids the RAM overflow and matches what the DC hardware expects to read the
# framebuffer from anyway.
CONFIG_LV_Z_VDB_ZEPHYR_REGION=y
CONFIG_LV_Z_VDB_ZEPHYR_REGION_NAME="GFX_MEMORY"

# Two rendering buffers, not one. ifx_dc_write() does not copy pixels - it
# points the display controller straight at the buffer LVGL hands it. With a
# single buffer that is the same memory the panel is actively scanning out, so
# every element flickers once per update. Mandatory with full refresh.
CONFIG_LV_Z_DOUBLE_VDB=y

CONFIG_DISPLAY=y
CONFIG_DISPLAY_LOG_LEVEL_ERR=y

CONFIG_LVGL=y
CONFIG_LV_Z_FULL_REFRESH=y
CONFIG_LV_COLOR_DEPTH_16=y
CONFIG_LV_USE_LOG=y

# --- Touch input ----------------------------------------------------------
#
# The FocalTech controller is already described in the board DTS on i2c0; all
# that is needed here is to build the driver and the input subsystem that
# carries its events into LVGL's indev layer.
CONFIG_INPUT=y
CONFIG_INPUT_FT5336=y

# The touch node declares no "int-gpios", so INPUT_FT5336_INTERRUPT defaults
# to n and the driver polls on the system workqueue every 10 ms. Because
# input_report() refuses to block when called from syswq, a full queue drops
# events rather than waiting - silently, apart from a warning.
#
# Each sample reports three events (X, Y, BTN_TOUCH), so the default 16-deep
# queue holds only ~53 ms of touch. A full-screen repaint takes ~47 ms of
# uninterrupted CPU, and the input thread defaults to preemptible priority 0 -
# the same as main - so it cannot preempt the repaint to drain the queue.
# Every repaint therefore sat on the edge of overflowing it, and dragging a
# slider (which legitimately repaints continuously) pushed it over: the log
# filled with "Event dropped, queue full" and presses went missing.
#
# Two independent changes, because queue depth alone is a guess that has to
# track repaint duration:
#   - a deeper queue absorbs the burst (64 x 3 events = ~213 ms of touch)
#   - the input thread keeps its default preemptible priority. Raising it to
#     a cooperative priority also works and drains with lower latency, but a
#     cooperative thread is never preempted, so any slow callback - a stray
#     LOG_INF over a 115200 UART in immediate mode is enough - starves the
#     main thread that LVGL runs on. That is a sharp edge to leave in a lab
#     exercise, and the deeper queue alone covers the burst.
CONFIG_INPUT_QUEUE_MAX_MSGS=64

# The touch controller and the BMI270 share i2c0, and the bus throws an
# occasional error event under load. Recovering from one is expensive: the
# SCB interrupt handler busy-waits up to 10 ms for the block to go idle and
# then logs, which in immediate log mode blocks the UART for several more
# milliseconds - all with the interrupt still being serviced. A burst of
# those during a drag pushed lv_timer_handler from 47 ms to over 200 ms.
#
# Polling at 50 Hz instead of 100 Hz halves the transactions on the bus and
# so roughly halves the number of error events, while staying comfortably
# above the ~21 fps the display can actually repaint at. Note the symbol is
# INPUT_FT5336_PERIOD_MS - the driver has no CONFIG_INPUT_FT5336_PERIOD, and
# a .conf setting that name is accepted silently and does nothing.
CONFIG_INPUT_FT5336_PERIOD_MS=20

# --- LED PWM --------------------------------------------------------------
#
# See the board overlay for the devicetree side. Without CONFIG_PWM the
# PWM_DT_SPEC_GET() calls in src/main.c compile but resolve to a driver API
# that was never built.
#
# TODO 1c: uncomment the line below. This is the half of Step 1 that
# lives in Kconfig rather than in devicetree: the overlay says the LEDs
# exist, and this says build the driver that drives them. Leaving it out
# does not fail in the overlay - it fails at link time, a long way away.
# CONFIG_PWM=y

# --- IMU ------------------------------------------------------------------
#
# bmi270 is on i2c0 at 0x68 with the accel0 alias, declared by the board.
CONFIG_SENSOR=y
CONFIG_BMI270=y

# --- Local module ---------------------------------------------------------
#
# modules/tilt_filter is pulled in by ZEPHYR_EXTRA_MODULES in CMakeLists.txt,
# but a module only contributes code when its own Kconfig symbol is set. This
# line is the switch. Set it to n and the build still succeeds - the tilt
# readout just becomes visibly jittery.
#
# TODO 2a: uncomment both lines below. The second one is the filter
# strength - the module declares it with a default, so setting it here
# is optional, and changing it is the quickest way to see a Kconfig
# value reach real code.
# CONFIG_TILT_FILTER=y
# CONFIG_TILT_FILTER_ALPHA_PERCENT=18

# --- Audio feedback -------------------------------------------------------
#
# The second local module, modules/beeper, plays a short tone through the
# board's TLV320DAC3100 and onboard speaker when a slider is released. It
# needs three subsystems underneath it:
#
#   I2S          carries the samples to the codec
#   AUDIO_CODEC  configures and routes the codec over i2c0 (it has no data
#                path of its own - see the comment at the top of beeper.c)
#   DMA          the I2S transmitter is fed by dma0 channel 1
#
# The codec, i2s0 and the clock divider that produces its 12.288 MHz MCLK
# are all described in the board overlay.
#
# TODO 3a: uncomment CONFIG_BEEPER below. Note the four symbols above it
# are already set: BEEPER depends on I2S and AUDIO_CODEC, and a symbol
# whose dependencies are unmet is silently dropped rather than reported,
# so turning it on without them would look like nothing happened.
CONFIG_I2S=y
CONFIG_AUDIO=y
CONFIG_AUDIO_CODEC=y
CONFIG_DMA=y

# CONFIG_BEEPER=y

# --- LVGL widgets and fonts used by the UI --------------------------------
#
# Each widget family is an independent Kconfig symbol so unused ones cost no
# flash. The dashboard uses sliders (which are built on bars), an arc for the
# tilt meter, and labels throughout.
CONFIG_LV_USE_LABEL=y
CONFIG_LV_USE_BAR=y
CONFIG_LV_USE_SLIDER=y
CONFIG_LV_USE_ARC=y

CONFIG_LV_FONT_MONTSERRAT_14=y
CONFIG_LV_FONT_MONTSERRAT_18=y
CONFIG_LV_FONT_MONTSERRAT_28=y
CONFIG_LV_FONT_MONTSERRAT_40=y

# Rounded corners, gradients and the arc's anti-aliased stroke all allocate
# from LVGL's own heap rather than the Zephyr heap. The smoke test's 16 KB is
# not enough once there are a dozen styled objects on screen.
CONFIG_LV_Z_MEM_POOL_SIZE=49152

# --- Diagnostics ----------------------------------------------------------
CONFIG_LOG=y
# Immediate mode so the build-stamp banner (see src/main.c) can never be lost
# to a deferred log ring buffer that doesn't get serviced if something early
# in the display init path hangs.
CONFIG_LOG_MODE_IMMEDIATE=y

CONFIG_MAIN_STACK_SIZE=8192
```

## src/main.c
```c
/*
 * Copyright (c) 2026 Infineon Technologies AG,
 * or an affiliate of Infineon Technologies AG.
 *
 * SPDX-License-Identifier: Apache-2.0
 *
 * DevCon 2026 PSOC Edge lab - Device Dashboard, cheat tier.
 *
 * Three on-board LEDs dimmed over hardware PWM from LVGL sliders, plus a live
 * tilt readout from the on-board BMI270. Nothing on this screen is simulated:
 * touch drives real hardware, and the meter follows a real sensor.
 *
 * The three lab touchpoints all meet here:
 *   - devicetree: the pwm-led0..2 aliases and accel0 resolved below only
 *     exist because of boards/kit_pse84_eval_pse846gps2dbzc4a_m55.overlay
 *   - modules:    LVGL arrives as a west module; tilt_filter is a local one
 *   - code:       the PWM, sensor and LVGL API calls in this file
 */

#include <zephyr/device.h>
#include <zephyr/devicetree.h>
#include <zephyr/drivers/display.h>
#include <zephyr/drivers/pwm.h>
#include <zephyr/drivers/sensor.h>
#include <zephyr/kernel.h>

#include <lvgl.h>
#include <math.h>
#include <stdio.h>

#ifdef CONFIG_TILT_FILTER
#include <tilt_filter.h>
#endif
#ifdef CONFIG_BEEPER
#include <beeper.h>
#endif

#include "ui.h"

#include <zephyr/logging/log.h>
LOG_MODULE_REGISTER(e84_dashboard);

/*
 * This guard exists only in the lab skeletons.
 *
 * Without it, an unfinished Step 1 produces around a hundred lines of
 * devicetree macro expansion errors - all of them real, none of them
 * saying what is actually wrong. The #error below says it in one line,
 * and the dummy definition in this branch keeps the rest of the file
 * quiet so that line is the only thing you have to read.
 */
#if !DT_NODE_EXISTS(DT_ALIAS(pwm_led0))

#error "Step 1 is not finished. The pwm-led0 alias does not exist yet, \
so there is no PWM channel for this file to reference. Go back to \
boards/kit_pse84_eval_pse846gps2dbzc4a_m55.overlay and complete TODO 1a \
and TODO 1b, then build again."

static const struct pwm_dt_spec led_pwm[UI_LED_COUNT];

#else

/*
 * Second half of the same guard, and a reminder that devicetree alone is
 * never enough. The aliases above now exist, but a node being enabled in
 * devicetree does not build the driver that binds to it - that is what
 * CONFIG_PWM does. Without it this file compiles perfectly well and then
 * fails at link time with an undefined reference to a generated device
 * symbol, which names no file and no line.
 */
#if !defined(CONFIG_PWM)
#error "Step 1 is not finished. The LED nodes are enabled in devicetree \
now, but CONFIG_PWM is still off, so the PWM driver is not being built \
and nothing can bind to those nodes. Complete TODO 1c in prj.conf, then \
build again."
#endif

/*
 * PWM_DT_SPEC_GET() captures the device pointer, channel, period and flags
 * from the devicetree at build time. If one of these aliases is missing the
 * failure is a compile error, not a runtime surprise - which is exactly what
 * is wanted for something attendees are editing by hand.
 */
static const struct pwm_dt_spec led_pwm[UI_LED_COUNT] = {
	PWM_DT_SPEC_GET(DT_ALIAS(pwm_led0)),
	PWM_DT_SPEC_GET(DT_ALIAS(pwm_led1)),
	PWM_DT_SPEC_GET(DT_ALIAS(pwm_led2)),
};

#endif

static const struct device *const imu = DEVICE_DT_GET(DT_ALIAS(accel0));

/*
 * How often LVGL is serviced, and how often the IMU is read. These used to be
 * the same thing: every pass repainted the whole screen, so the display
 * controller set the pace and the sensor was simply read once per frame. Now
 * that the UI only repaints when a value changes, an idle pass costs
 * microseconds, and the two rates are free to differ.
 */
#define UI_TICK_MS       10
#define IMU_PERIOD_MS    50
#define REPORT_PERIOD_MS 5000U

/* Starting brightness per channel - chosen so the panel looks alive at boot. */
static const uint8_t initial_percent[UI_LED_COUNT] = { 70, 45, 20 };

#ifdef CONFIG_TILT_FILTER
static struct tilt_filter pitch_filter;
static struct tilt_filter roll_filter;
#endif

/*
 * Resting orientation, captured at startup and subtracted from every reading.
 *
 * Without this the meter reads whatever angle the EVK happens to be sitting
 * at - on this desk, -52 degrees of roll, because the board does not lie flat
 * once the panel is mounted on its stand-offs. Every attendee's bench is
 * different, so an absolute reading makes the demo behave differently on
 * every table. Zeroing at boot makes "flat" mean "however you left it", which
 * is what the attendee expects when they pick the board up and tip it.
 *
 * Subtracting the resting pitch and roll is not enough, though, and the
 * difference is visible rather than academic. Pitch is measured against true
 * vertical, so once the board already leans, a given physical rotation lands
 * only partly in the pitch plane: at this board's ~54 degrees of resting
 * roll, tipping it 20 degrees moves the reading about 10.5, and drags roll
 * 1.6 degrees along with it. The meter under-reads by roughly 40% and the
 * two axes bleed into each other.
 *
 * Angles do not compose by subtraction. Rotations do. So capture the resting
 * gravity vector instead of the resting angles, build the rotation that takes
 * it to +Z, and apply that to every later sample before deriving the angles.
 * The attendee then gets full sensitivity and independent axes whatever angle
 * the board is propped at, which matters because in a room full of EVKs no
 * two will be propped alike.
 */
static float ref_rot[3][3] = {
	{ 1.0f, 0.0f, 0.0f },
	{ 0.0f, 1.0f, 0.0f },
	{ 0.0f, 0.0f, 1.0f },
};

static int led_set_percent(uint8_t index, uint8_t percent)
{
	/*
	 * TODO 1d: drive this LED at `percent` brightness.
	 *
	 * led_pwm[index] is a struct pwm_dt_spec, filled in from the overlay
	 * you edited in Step 1. It carries the device, the channel, the period
	 * devicetree declared, and the polarity flags.
	 *
	 * Use pwm_set_pulse_dt(). It takes the spec and a pulse width in the
	 * same units as the period, so a percentage means scaling the period
	 * from the spec rather than hardcoding a number here - the overlay is
	 * allowed to change the period and this should still be correct.
	 *
	 * Watch the arithmetic: period * 100 overflows a uint32_t for any
	 * period longer than about 43 ms.
	 *
	 * Return what pwm_set_pulse_dt() returns; the caller logs failures.
	 *
	 * https://docs.zephyrproject.org/latest/hardware/peripherals/pwm.html
	 */
	ARG_UNUSED(index);
	ARG_UNUSED(percent);

	return 0; /* Replace this. */
	/*
	 * TODO 1d - ANSWER.
	 *
	 * Copy everything between the #if 0 and the #endif, paste it
	 * here, then delete this whole block.
	 * Then delete the two ARG_UNUSED lines and the `return 0;` just above,
	 * which only exists so the skeleton compiles.
	 */
#if 0 /* ==== copy from the next line ==== */

	/*
	 * Pulse width is a fraction of the period that devicetree declared, so
	 * the arithmetic stays correct if the period is later changed in the
	 * overlay. uint64_t because period_ns * 100 overflows 32 bits for any
	 * period above ~43 ms.
	 */
	uint32_t pulse = (uint32_t)(((uint64_t)led_pwm[index].period * percent) / 100U);

	return pwm_set_pulse_dt(&led_pwm[index], pulse);

#endif /* ==== stop copying at the line above ==== */

}

static void on_brightness(uint8_t index, uint8_t percent)
{
	int ret = led_set_percent(index, percent);

	if (ret < 0) {
		LOG_ERR("LED%u set %u%% failed (%d)", index, percent, ret);
	}
}

/*
 * Convert a gravity vector into pitch/roll in millidegrees.
 *
 * With the board flat, gravity sits almost entirely on Z. Tipping it moves
 * that component onto X or Y, and the arctangent of the ratio is the angle.
 * atan2f() rather than atanf() so the sign of both operands is respected and
 * the result covers the full +/-180 range instead of folding at 90.
 *
 * Which axis is which is a property of how the BMI270 is placed on this PCB,
 * not of how the board sits on the desk, and on this board it is not the
 * mapping you would guess:
 *
 *   sensor Y -> runs up and down the panel -> tipping the board forward and
 *               back moves gravity along it, so Y gives PITCH
 *   sensor X -> runs left and right across the panel -> tipping the board
 *               left and right moves gravity along it, so X gives ROLL
 *
 * The first version of this function had those two swapped, which is only
 * detectable by picking the board up and tilting it - every static reading
 * looks perfectly plausible. Signs are chosen so that tilting the far edge
 * up reads positive pitch and dropping the right side reads positive roll,
 * which is what someone holding the board expects to see.
 */
static void accel_to_angles(const float v[3], int32_t *pitch_mdeg, int32_t *roll_mdeg)
{
	const float rad_to_mdeg = 57295.779513f; /* (180/pi) * 1000 */

	*pitch_mdeg = (int32_t)(atan2f(-v[1], v[2]) * rad_to_mdeg);
	*roll_mdeg = (int32_t)(atan2f(v[0], sqrtf(v[1] * v[1] + v[2] * v[2])) * rad_to_mdeg);
}

/*
 * Build the rotation that takes the measured resting gravity vector onto +Z,
 * i.e. that makes "however the board is propped right now" mean level.
 *
 * This is Rodrigues' rotation formula for the specific case of rotating a
 * unit vector a onto b = (0,0,1). The axis is v = a x b = (ay, -ax, 0) and
 * the cosine of the angle is c = a.z, which collapses the general form
 * R = I + K + K^2/(1+c) into the closed form below.
 *
 * The 1/(1+c) term is singular when c = -1, i.e. the board was face-down at
 * boot. There is no unique rotation in that case (any axis in the XY plane
 * works), so pick one: a half turn about X.
 */
static void build_ref_rot(float ax, float ay, float az)
{
	float k;

	if (az < -0.999f) {
		ref_rot[0][0] = 1.0f;  ref_rot[0][1] = 0.0f;  ref_rot[0][2] = 0.0f;
		ref_rot[1][0] = 0.0f;  ref_rot[1][1] = -1.0f; ref_rot[1][2] = 0.0f;
		ref_rot[2][0] = 0.0f;  ref_rot[2][1] = 0.0f;  ref_rot[2][2] = -1.0f;
		return;
	}

	k = 1.0f / (1.0f + az);

	ref_rot[0][0] = 1.0f - ax * ax * k;
	ref_rot[0][1] = -ax * ay * k;
	ref_rot[0][2] = -ax;

	ref_rot[1][0] = -ax * ay * k;
	ref_rot[1][1] = 1.0f - ay * ay * k;
	ref_rot[1][2] = -ay;

	ref_rot[2][0] = ax;
	ref_rot[2][1] = ay;
	ref_rot[2][2] = 1.0f - (ax * ax + ay * ay) * k;
}

static void apply_ref_rot(const float in[3], float out[3])
{
	for (int r = 0; r < 3; r++) {
		out[r] = ref_rot[r][0] * in[0] + ref_rot[r][1] * in[1] +
			 ref_rot[r][2] * in[2];
	}
}

/*
 * Bring the accelerometer out of suspend.
 *
 * The BMI270 powers up with both the accelerometer and gyroscope disabled.
 * device_is_ready() still returns true and sensor_sample_fetch() still returns
 * 0 in that state - the driver reads the data registers successfully, they
 * just contain zeroes. That is the worst kind of failure to debug from a UI,
 * because a perfectly level reading is exactly what a board sitting on a desk
 * is supposed to produce.
 *
 * Sampling frequency must be set *last*: in this driver it is the write that
 * also selects the power mode, so anything configured after it is applied to a
 * running sensor.
 *
 * Only the accelerometer is configured. The dashboard derives tilt from
 * gravity alone, and leaving the gyroscope suspended saves a few hundred uA.
 */
static int imu_configure(void)
{
	struct sensor_value full_scale = { .val1 = 2, .val2 = 0 };   /* +/- 2 g */
	struct sensor_value oversampling = { .val1 = 1, .val2 = 0 }; /* normal mode */
	struct sensor_value sampling_freq = { .val1 = 100, .val2 = 0 }; /* Hz */
	int ret;

	ret = sensor_attr_set(imu, SENSOR_CHAN_ACCEL_XYZ, SENSOR_ATTR_FULL_SCALE, &full_scale);
	if (ret == 0) {
		ret = sensor_attr_set(imu, SENSOR_CHAN_ACCEL_XYZ, SENSOR_ATTR_OVERSAMPLING,
				      &oversampling);
	}
	if (ret == 0) {
		ret = sensor_attr_set(imu, SENSOR_CHAN_ACCEL_XYZ,
				      SENSOR_ATTR_SAMPLING_FREQUENCY, &sampling_freq);
	}

	if (ret != 0) {
		LOG_ERR("IMU configuration failed (%d)", ret);
	}

	return ret;
}

/* Read one raw gravity sample into g units. Returns 0 on success. */
static int imu_read_accel(float v[3])
{
	struct sensor_value accel[3];
	int ret;

	/*
	 * SENSOR_CHAN_ALL, not SENSOR_CHAN_ACCEL_XYZ. The API allows a driver
	 * to support per-channel fetches, but bmi270_sample_fetch() reads
	 * accel, gyro and temperature in one 12-byte burst and rejects any
	 * narrower request with -ENOTSUP. Asking for the narrower channel here
	 * fails every single poll.
	 *
	 * The *read* below is per-channel - that part the driver does support.
	 * Only the fetch is all-or-nothing.
	 */
	ret = sensor_sample_fetch(imu);
	if (ret != 0) {
		return ret;
	}

	ret = sensor_channel_get(imu, SENSOR_CHAN_ACCEL_XYZ, accel);
	if (ret != 0) {
		return ret;
	}

	for (int i = 0; i < 3; i++) {
		v[i] = (float)sensor_value_to_double(&accel[i]);
	}

	return 0;
}

/* Read one sample and convert it. Returns 0 on success. */
static int imu_read_angles(int32_t *pitch_mdeg, int32_t *roll_mdeg)
{
	float raw[3];
	float level[3];
	int ret = imu_read_accel(raw);

	if (ret != 0) {
		return ret;
	}

	/*
	 * Rotate into the frame captured at boot before deriving angles, so
	 * the readings are measured from where the board was resting rather
	 * than from true horizontal.
	 */
	apply_ref_rot(raw, level);
	accel_to_angles(level, pitch_mdeg, roll_mdeg);

	return 0;
}

/*
 * Average a short burst of samples to establish the resting orientation.
 *
 * Note this averages the gravity *vector* and then derives a rotation from
 * it, rather than averaging the pitch and roll angles and subtracting them
 * later. Subtracting angles looks equivalent and is not: pitch is measured
 * against true vertical, so on a board already propped at 54 degrees a 20
 * degree tip only registers as about 10.5, and it disturbs the roll reading
 * on the way past. Rotating the frame keeps both axes at full sensitivity
 * and independent of each other, whatever angle the board is propped at -
 * which matters in a room where no two boards will be propped alike.
 */
static void imu_capture_zero(void)
{
	const int discard = 12;
	const int samples = 16;
	float sum[3] = { 0.0f, 0.0f, 0.0f };
	float norm;
	int taken = 0;

	/*
	 * Discard the first readings rather than averaging them in.
	 *
	 * The accelerometer does not deliver its final value the instant it
	 * leaves suspend - the output ramps towards the true angle over the
	 * first few hundred milliseconds. Averaging across that ramp captured a
	 * zero reference ~9.8 degrees away from the resting angle on this
	 * board, so the meter settled at a constant non-zero reading after
	 * boot, which looks exactly like a broken calibration.
	 */
	for (int i = 0; i < discard; i++) {
		float v[3];

		(void)imu_read_accel(v);
		k_sleep(K_MSEC(25));
	}

	for (int i = 0; i < samples; i++) {
		float v[3];

		if (imu_read_accel(v) == 0) {
			sum[0] += v[0];
			sum[1] += v[1];
			sum[2] += v[2];
			taken++;
		}
		k_sleep(K_MSEC(15));
	}

	if (taken == 0) {
		LOG_WRN("tilt zero reference: no samples, using board axes as level");
		return;
	}

	/*
	 * Normalise before building the rotation. Rodrigues' formula is only a
	 * rotation for a unit vector, and this one is nowhere near unit length
	 * anyway - sensor_value_to_double() returns m/s^2, so a board at rest
	 * reads about 9.81, not 1. Feeding that in unnormalised would quietly
	 * scale every later reading. The floor below is well under 1 g in
	 * either unit, so it only catches a dead or free-falling sensor.
	 */
	norm = sqrtf(sum[0] * sum[0] + sum[1] * sum[1] + sum[2] * sum[2]);
	if (norm < 0.1f) {
		LOG_WRN("tilt zero reference: |g| too small to trust, staying level");
		return;
	}

	build_ref_rot(sum[0] / norm, sum[1] / norm, sum[2] / norm);

	/* Printed as a unit vector in thousandths: 1000 is full gravity. */
	LOG_INF("tilt zero reference: g = (%d, %d, %d)/1000 over %d samples",
		(int)(sum[0] / norm * 1000.0f), (int)(sum[1] / norm * 1000.0f),
		(int)(sum[2] / norm * 1000.0f), taken);
}

int main(void)
{
	const struct device *display_dev;
	bool imu_ok;
	bool imu_warned = false;
	uint32_t tick = 0;
	uint32_t next_imu_ms = 0;
	uint32_t next_report_ms = REPORT_PERIOD_MS;
	int ret;

	/*
	 * Per-build stamp, logged before anything else runs. OpenOCD can report
	 * a successful program + verify on this chip family while leaving the
	 * previous image running, so a clean programmer log is not evidence
	 * that a flash landed. A compile timestamp can be cross-checked against
	 * the ELF's mtime, which makes it the one value that identifies the
	 * running image. Requires a pristine build (west build -p always).
	 */
	LOG_INF("e84-dashboard build stamp: " __DATE__ " " __TIME__);

	display_dev = DEVICE_DT_GET(DT_CHOSEN(zephyr_display));
	if (!device_is_ready(display_dev)) {
		LOG_ERR("display device not ready");
		return 0;
	}

	for (uint8_t i = 0; i < UI_LED_COUNT; i++) {
		if (!pwm_is_ready_dt(&led_pwm[i])) {
			LOG_ERR("PWM channel %u not ready", i);
			return 0;
		}
		ret = led_set_percent(i, initial_percent[i]);
		if (ret < 0) {
			LOG_ERR("LED%u initial set failed (%d)", i, ret);
			return 0;
		}
	}
	LOG_INF("all %d PWM channels ready", UI_LED_COUNT);

	/*
	 * A missing IMU is not fatal. The LED half of the dashboard is the part
	 * attendees build, and losing the tilt meter to one flaky board should
	 * not cost someone the whole exercise - the status line says so instead.
	 */
	imu_ok = device_is_ready(imu);
	if (!imu_ok) {
		LOG_WRN("IMU %s not ready - tilt meter disabled", imu->name);
	} else {
		imu_ok = (imu_configure() == 0);
		if (imu_ok) {
			imu_capture_zero();
		}
	}

#ifdef CONFIG_TILT_FILTER
	tilt_filter_reset(&pitch_filter);
	tilt_filter_reset(&roll_filter);
#endif

	/*
	 * Audio is also non-fatal. It is the last thing brought up and the
	 * first thing to lose: a board with a codec that does not answer on
	 * i2c0 still runs the whole dashboard, just without the tick.
	 */
#ifdef CONFIG_BEEPER
	/*
	 * TODO 3b: bring the beeper module up.
	 *
	 * modules/beeper exposes beeper_init() - see its header. It returns a
	 * negative errno if the codec did not answer on i2c0.
	 *
	 * That must not be fatal. A board whose codec is unreachable should
	 * still run the whole dashboard, just without the tick, so log a
	 * warning and carry on rather than returning.
	 */
	/*
	 * TODO 3b - ANSWER.
	 *
	 * Copy everything between the #if 0 and the #endif, paste it
	 * here, then delete this whole block.
	 * Paste it directly below this block.
	 */
#if 0 /* ==== copy from the next line ==== */

	ret = beeper_init();
	if (ret < 0) {
		LOG_WRN("beeper init failed (%d) - touch feedback disabled", ret);
	}

#endif /* ==== stop copying at the line above ==== */

#endif

	ui_init(on_brightness, initial_percent);

	/*
	 * LVGL will not move a slider while the finger is down until it has
	 * travelled scroll_limit pixels from the press point - see the
	 * check_drag branch of update_knob_pos() in lv_slider.c. The gate is
	 * skipped on release, so below that distance a press looks completely
	 * dead and then snaps to the finger the moment it lifts.
	 *
	 * The limit exists so a slider does not swallow a scroll gesture that
	 * was meant for a scrollable parent. Nothing in this UI scrolls - the
	 * active screen and every container have LV_OBJ_FLAG_SCROLLABLE
	 * cleared - so the default 10 px buys nothing here and only costs
	 * responsiveness.
	 *
	 * Zero rather than one: at one, a finger held perfectly still gives an
	 * offset of zero, which is still below the limit, so the knob does not
	 * move until release. Zero removes the gate entirely and gives
	 * tap-to-set, which is what a brightness control should do. It is only
	 * safe because update_knob_pos() also gives up when the input device
	 * has latched onto a scroll object, and nothing here can become one.
	 *
	 * The default is a hardcoded #define in lv_indev.c with no Kconfig
	 * symbol behind it, so it has to be set at runtime.
	 */
	for (lv_indev_t *indev = lv_indev_get_next(NULL); indev != NULL;
	     indev = lv_indev_get_next(indev)) {
		if (lv_indev_get_type(indev) == LV_INDEV_TYPE_POINTER) {
			lv_indev_set_scroll_limit(indev, 0);
		}
	}

	/*
	 * The first flush is discarded by the infineon_dc driver, so it is
	 * issued before blanking is turned off to avoid showing a partial
	 * frame.
	 */
	lv_timer_handler();

	ret = display_blanking_off(display_dev);
	if (ret < 0 && ret != -ENOSYS) {
		LOG_ERR("blanking off failed (%d)", ret);
		return 0;
	}

	/*
	 * The Waveshare panel's backlight is driven over I2C (register 0x86),
	 * independent of the MIPI DSI video link. Without this the frames are
	 * correct but the screen stays dark.
	 */
	(void)display_set_brightness(display_dev, 255);

	ui_set_status(imu_ok ? "LVGL + hardware PWM + BMI270" : "IMU unavailable - LEDs only");

	while (1) {
		uint32_t now = k_uptime_get_32();

		/*
		 * The sensor and the UI run on separate cadences now that the
		 * screen only repaints on change. LVGL is serviced every
		 * UI_TICK_MS so a touch is picked up within one tick of the
		 * FocalTech driver reporting it, while the BMI270 keeps the
		 * much slower poll it actually needs - the tilt meter shows
		 * tenths of a degree, and reading it a hundred times a second
		 * would only add traffic to the I2C bus the display panel
		 * shares.
		 */
		if (imu_ok && (int32_t)(now - next_imu_ms) >= 0) {
			int32_t pitch, roll;

			next_imu_ms = now + IMU_PERIOD_MS;

			ret = imu_read_angles(&pitch, &roll);
			if (ret == 0) {
				/*
				 * No offset subtraction here: imu_read_angles()
				 * already rotated the sample into the frame
				 * captured at boot, so these are angles from
				 * rest.
				 */

				/*
				 * Raw readings jitter by a degree or two even
				 * with the board sitting still, which makes the
				 * meter twitch constantly. The local tilt_filter
				 * module smooths them; build with
				 * CONFIG_TILT_FILTER=n to see the difference.
				 */
#ifdef CONFIG_TILT_FILTER
				pitch = tilt_filter_update(&pitch_filter, pitch);
				roll = tilt_filter_update(&roll_filter, roll);
#endif
				ui_set_tilt(pitch, roll);

				/*
				 * Periodic readout. Not for the attendee's
				 * benefit - it is the only way to confirm the
				 * sensor path from a terminal when nobody is
				 * looking at the panel.
				 */
				if (++tick % 100 == 0) {
					LOG_INF("pitch %d mdeg  roll %d mdeg", pitch, roll);
				}
			} else if (!imu_warned) {
				/*
				 * Logged once, not every poll. In immediate log
				 * mode a per-iteration warning saturates the
				 * UART and starves the LVGL refresh, which makes
				 * a sensor problem look like a display problem.
				 */
				imu_warned = true;
				LOG_WRN("IMU read failed (%d) - tilt meter frozen", ret);
				ui_set_status("IMU read failed - LEDs still live");
			}
		}

		{
			/*
			 * TEMPORARY DIAGNOSTIC - not part of the lab.
			 *
			 * Counts how many of these ticks actually repainted.
			 * A repaint hands the display controller a different
			 * frame buffer, and the infineon_dc driver then blocks
			 * until the next frame-complete interrupt, so a real
			 * repaint costs tens of milliseconds while an idle
			 * tick costs tens of microseconds. The two are
			 * trivially separable by time.
			 */
			static uint32_t worst_us;
			static uint32_t repaints;
			uint32_t t0 = k_cycle_get_32();
			uint32_t dt;

			lv_timer_handler();

			dt = k_cyc_to_us_floor32(k_cycle_get_32() - t0);

			if (dt >= 20000U) {
				repaints++;
				worst_us = MAX(worst_us, dt);
			}

			if ((int32_t)(now - next_report_ms) >= 0) {
				next_report_ms = now + REPORT_PERIOD_MS;
				LOG_INF("repaints %u / %u ms (worst %u us)",
					repaints, REPORT_PERIOD_MS, worst_us);
				repaints = 0;
				worst_us = 0;
			}
		}

		k_sleep(K_MSEC(UI_TICK_MS));
	}

	return 0;
}
```

## src/ui.c
```c
/*
 * Copyright (c) 2026 Infineon Technologies AG,
 * or an affiliate of Infineon Technologies AG.
 *
 * SPDX-License-Identifier: Apache-2.0
 *
 * DevCon 2026 PSOC Edge lab - Device Dashboard UI (cheat tier).
 *
 * All layout is absolute. LVGL's flex/grid layouts would be tidier, but this
 * screen is drawn once at a fixed resolution and absolute coordinates are far
 * easier to follow for someone meeting LVGL for the first time - which is the
 * entire audience for this file.
 *
 * A note on width: the display controller is configured for 832x480 total
 * timing, of which 800x480 is active. LVGL therefore believes the screen is
 * 832 px wide, and anything drawn beyond x=799 lands in the horizontal
 * blanking interval and is never visible. UI_W below is the usable width.
 */

#include "ui.h"

#include <lvgl.h>
#include <stdio.h>
#include <zephyr/sys/util.h>

/*
 * The beeper module only contributes a header when its Kconfig symbol is
 * set, so both the include and the calls below are guarded. Set
 * CONFIG_BEEPER=n and the dashboard builds and runs exactly as before,
 * silently.
 */
#ifdef CONFIG_BEEPER
#include <beeper.h>
#endif

/* ------------------------------------------------------------------ */
/* Palette                                                            */
/* ------------------------------------------------------------------ */

/*
 * Infineon Ocean (#0A8276) is the brand anchor. Everything else is a neutral
 * dark scale chosen to sit under it without competing - on an 800x480 panel
 * viewed from across a training room, contrast matters more than hue.
 */
#define C_OCEAN      0x0A8276
#define C_OCEAN_DEEP 0x05514A
#define C_OCEAN_LT   0x1ECBB5

#define C_BG         0x050D10
#define C_BG_DEEP    0x0A1A1F
#define C_CARD       0x102227
#define C_CARD_DEEP  0x0A171B
#define C_BORDER     0x1C3B42
#define C_TEXT       0xEAF4F3
#define C_MUTED      0x7E9A9C

/* One colour per LED, matching what the attendee actually sees on the board. */
static const uint32_t led_color[UI_LED_COUNT] = {
	0xFF5A52, /* LED0 - red   */
	0x3CE07A, /* LED1 - green */
	0x4DA3FF, /* LED2 - blue  */
};

/*
 * Two names per LED, because they disagree and the disagreement is exactly
 * the kind of thing that costs an attendee ten minutes.
 *
 * The board's silkscreen counts from one: LED1 red, LED2 green, LED3 blue.
 * The devicetree aliases count from zero: pwm-led0, pwm-led1, pwm-led2. So
 * the alias the attendee edits is always one lower than the number printed
 * next to the LED they are watching. Showing both on the card turns that
 * into a lookup table instead of a trap.
 */
static const char *const led_name[UI_LED_COUNT] = {
	"LED1  RED",
	"LED2  GREEN",
	"LED3  BLUE",
};

static const char *const led_alias[UI_LED_COUNT] = {
	"pwm-led0",
	"pwm-led1",
	"pwm-led2",
};

/* ------------------------------------------------------------------ */
/* Layout                                                             */
/* ------------------------------------------------------------------ */

#define UI_W        800
#define UI_H        480

#define HEADER_H    56

#define LEFT_X      14
#define LEFT_W      452
#define CARD_H      124
#define CARD_GAP    10
#define CARD_Y0     (HEADER_H + 12)

#define RIGHT_X     480
#define RIGHT_W     306

#define ARC_SIZE    238

/* ------------------------------------------------------------------ */
/* State                                                              */
/* ------------------------------------------------------------------ */

static ui_brightness_cb_t brightness_cb;

static lv_obj_t *pct_label[UI_LED_COUNT];
static lv_obj_t *tilt_value_label;
static lv_obj_t *tilt_arc;
static lv_obj_t *pitch_label;
static lv_obj_t *roll_label;
static lv_obj_t *status_label;

/* ------------------------------------------------------------------ */
/* Helpers                                                            */
/* ------------------------------------------------------------------ */

static lv_obj_t *panel_create(lv_obj_t *parent, int32_t x, int32_t y, int32_t w, int32_t h)
{
	lv_obj_t *p = lv_obj_create(parent);

	lv_obj_set_pos(p, x, y);
	lv_obj_set_size(p, w, h);

	/*
	 * lv_obj_create() gives a scrollable container with default padding and
	 * a light theme background. All three are wrong here, so they are
	 * cleared explicitly rather than fought with later.
	 */
	lv_obj_remove_flag(p, LV_OBJ_FLAG_SCROLLABLE);
	lv_obj_set_style_pad_all(p, 0, LV_PART_MAIN);

	/*
	 * Flat fill, not a gradient.
	 *
	 * The framebuffer is RGB565, so a gradient only has 32 distinct levels
	 * of red or blue to work with. Spread over a card this wide that lands
	 * as visible stair-stepping rather than a smooth wash, and LVGL 9 has
	 * no gradient dithering to hide it. Going to 24- or 32-bit colour is
	 * not an option here: two full-screen 800x480 buffers already take
	 * 1500 KiB of the 2 MB graphics region, and 32-bit would need 3000.
	 * Solid colours look deliberate, cost nothing, and render faster.
	 */
	lv_obj_set_style_bg_color(p, lv_color_hex(C_CARD), LV_PART_MAIN);
	lv_obj_set_style_bg_opa(p, LV_OPA_COVER, LV_PART_MAIN);

	lv_obj_set_style_border_color(p, lv_color_hex(C_BORDER), LV_PART_MAIN);
	lv_obj_set_style_border_width(p, 1, LV_PART_MAIN);
	lv_obj_set_style_radius(p, 10, LV_PART_MAIN);

	return p;
}

static lv_obj_t *label_create(lv_obj_t *parent, const lv_font_t *font, uint32_t color,
			      const char *text)
{
	lv_obj_t *l = lv_label_create(parent);

	lv_label_set_text(l, text);
	lv_obj_set_style_text_font(l, font, LV_PART_MAIN);
	lv_obj_set_style_text_color(l, lv_color_hex(color), LV_PART_MAIN);

	return l;
}

/* ------------------------------------------------------------------ */
/* Slider handling                                                    */
/* ------------------------------------------------------------------ */

static void slider_event_cb(lv_event_t *e)
{
	/*
	 * The LED index was stashed as the event user_data when the callback
	 * was registered. Casting through uintptr_t rather than int keeps this
	 * clean on both 32- and 64-bit builds (the native_sim target is 64-bit).
	 */
	uint8_t index = (uint8_t)(uintptr_t)lv_event_get_user_data(e);
	lv_obj_t *slider = lv_event_get_target_obj(e);
	int32_t value = lv_slider_get_value(slider);
	char buf[8];

	snprintf(buf, sizeof(buf), "%d%%", (int)value);
	lv_label_set_text(pct_label[index], buf);

	if (brightness_cb != NULL) {
		brightness_cb(index, (uint8_t)value);
	}
}

/*
 * Feedback fires on press and on release, not on every value change.
 *
 * VALUE_CHANGED is emitted continuously while a finger is moving - dozens of
 * times a second - so a tone there is a buzz rather than a tick. The two ends
 * of the gesture are the moments worth marking: the press acknowledges the
 * touch, and the release is where the value actually lands on this panel.
 *
 * The press tone is lower and shorter. That ordering is not arbitrary - a
 * low-then-high pair is heard as one gesture, the way a physical button
 * sounds different going down and coming back up, whereas two tones at the
 * same pitch sound like the thing fired twice.
 */
#ifdef CONFIG_BEEPER
/*
 * TODO 3c (part 1 of 2): write the two feedback callbacks.
 *
 * Both take an lv_event_t * and return void. Neither needs anything out
 * of the event, so ARG_UNUSED(e) keeps the compiler quiet.
 *
 *   slider_pressed_cb   calls beeper_press()
 *   slider_released_cb  calls beeper_click()
 *
 * Both are declared in modules/beeper/include/beeper.h, already included
 * at the top of this file.
 *
 * Part 2 registers them - see TODO 3c further down in led_card_create().
 */
/*
 * TODO 3c part 1 - ANSWER.
 *
 * Copy everything between the #if 0 and the #endif, paste it
 * here, then delete this whole block.
 * Paste it directly below this block.
 */
#if 0 /* ==== copy from the next line ==== */

static void slider_pressed_cb(lv_event_t *e)
{
	ARG_UNUSED(e);
	beeper_press();
}

static void slider_released_cb(lv_event_t *e)
{
	ARG_UNUSED(e);
	beeper_click();
}

#endif /* ==== stop copying at the line above ==== */

#endif

static void led_card_create(lv_obj_t *parent, uint8_t index, uint8_t initial)
{
	int32_t y = CARD_Y0 + index * (CARD_H + CARD_GAP);
	lv_obj_t *card = panel_create(parent, LEFT_X, y, LEFT_W, CARD_H);
	lv_obj_t *accent;
	lv_obj_t *name;
	lv_obj_t *alias;
	lv_obj_t *slider;
	char buf[8];

	/* Colour chip down the left edge - the only hue cue at a glance. */
	accent = lv_obj_create(card);
	lv_obj_set_pos(accent, 0, 18);
	lv_obj_set_size(accent, 6, CARD_H - 36);
	lv_obj_remove_flag(accent, LV_OBJ_FLAG_SCROLLABLE);
	lv_obj_set_style_pad_all(accent, 0, LV_PART_MAIN);
	lv_obj_set_style_border_width(accent, 0, LV_PART_MAIN);
	lv_obj_set_style_radius(accent, 3, LV_PART_MAIN);
	lv_obj_set_style_bg_color(accent, lv_color_hex(led_color[index]), LV_PART_MAIN);
	lv_obj_set_style_bg_opa(accent, LV_OPA_COVER, LV_PART_MAIN);

	name = label_create(card, &lv_font_montserrat_18, C_TEXT, led_name[index]);
	lv_obj_set_pos(name, 24, 14);

	alias = label_create(card, &lv_font_montserrat_14, C_MUTED, led_alias[index]);
	lv_obj_set_pos(alias, 24, 38);

	snprintf(buf, sizeof(buf), "%u%%", initial);
	pct_label[index] = label_create(card, &lv_font_montserrat_28, led_color[index], buf);
	lv_obj_align(pct_label[index], LV_ALIGN_TOP_RIGHT, -20, 10);

	slider = lv_slider_create(card);
	lv_obj_set_pos(slider, 24, 70);
	lv_obj_set_size(slider, LEFT_W - 48, 26);
	lv_slider_set_range(slider, 0, 100);
	lv_slider_set_value(slider, initial, LV_ANIM_OFF);

	/*
	 * A 16 px track is about 2.4 mm on this panel - fine for a mouse, mean
	 * for a fingertip. The track is tall enough to aim at, and the click
	 * area is extended past it so a press that lands just above or below
	 * still grabs the slider the attendee was reaching for rather than
	 * falling through to the card behind it.
	 */
	lv_obj_set_ext_click_area(slider, 14);

	/* Track. */
	lv_obj_set_style_bg_color(slider, lv_color_hex(C_BG_DEEP), LV_PART_MAIN);
	lv_obj_set_style_border_color(slider, lv_color_hex(C_BORDER), LV_PART_MAIN);
	lv_obj_set_style_border_width(slider, 1, LV_PART_MAIN);

	/* Filled portion, in the LED's own colour. */
	lv_obj_set_style_bg_color(slider, lv_color_hex(led_color[index]), LV_PART_INDICATOR);
	lv_obj_set_style_bg_opa(slider, LV_OPA_COVER, LV_PART_INDICATOR);

	/* Knob - oversized on purpose; this is a finger-driven 4.3" panel. */
	lv_obj_set_style_bg_color(slider, lv_color_hex(C_TEXT), LV_PART_KNOB);
	lv_obj_set_style_pad_all(slider, 8, LV_PART_KNOB);

	lv_obj_add_event_cb(slider, slider_event_cb, LV_EVENT_VALUE_CHANGED,
			    (void *)(uintptr_t)index);

#ifdef CONFIG_BEEPER
	/*
	 * TODO 3c (part 2 of 2): register the two callbacks you just wrote.
	 *
	 * lv_obj_add_event_cb() takes the object, the callback, the event code
	 * and a user-data pointer (NULL here - the callbacks ignore it).
	 *
	 * The codes you want are LV_EVENT_PRESSED and LV_EVENT_RELEASED. Note
	 * the slider above already registers LV_EVENT_VALUE_CHANGED for the
	 * percentage readout; these are two further registrations on the same
	 * object, not a replacement for it. An object can carry as many as you
	 * like and LVGL calls them in registration order.
	 *
	 * Resist using VALUE_CHANGED for the tone. Read the comment above
	 * slider_pressed_cb for why that turns a tick into a buzz.
	 *
	 * https://docs.lvgl.io/master/API/core/lv_obj_event.html
	 */
	/*
	 * TODO 3c part 2 - ANSWER.
	 *
	 * Copy everything between the #if 0 and the #endif, paste it
	 * here, then delete this whole block.
	 * Paste it directly below this block.
	 */
#if 0 /* ==== copy from the next line ==== */

	lv_obj_add_event_cb(slider, slider_pressed_cb, LV_EVENT_PRESSED, NULL);
	lv_obj_add_event_cb(slider, slider_released_cb, LV_EVENT_RELEASED, NULL);

#endif /* ==== stop copying at the line above ==== */

#endif
}

/* ------------------------------------------------------------------ */
/* Public                                                             */
/* ------------------------------------------------------------------ */

void ui_init(ui_brightness_cb_t cb, const uint8_t initial_percent[UI_LED_COUNT])
{
	lv_obj_t *scr = lv_screen_active();
	lv_obj_t *header;
	lv_obj_t *title;
	lv_obj_t *subtitle;
	lv_obj_t *tilt_card;
	lv_obj_t *status_card;
	lv_obj_t *caption;

	brightness_cb = cb;

	/* Screen background: flat fill - see panel_create() on RGB565 banding. */
	lv_obj_set_style_bg_color(scr, lv_color_hex(C_BG), LV_PART_MAIN);
	lv_obj_remove_flag(scr, LV_OBJ_FLAG_SCROLLABLE);

	/* ---- Header ---- */
	header = lv_obj_create(scr);
	lv_obj_set_pos(header, 0, 0);
	lv_obj_set_size(header, UI_W, HEADER_H);
	lv_obj_remove_flag(header, LV_OBJ_FLAG_SCROLLABLE);
	lv_obj_set_style_pad_all(header, 0, LV_PART_MAIN);
	lv_obj_set_style_radius(header, 0, LV_PART_MAIN);
	lv_obj_set_style_border_width(header, 0, LV_PART_MAIN);
	lv_obj_set_style_bg_color(header, lv_color_hex(C_OCEAN), LV_PART_MAIN);
	lv_obj_set_style_bg_opa(header, LV_OPA_COVER, LV_PART_MAIN);

	title = label_create(header, &lv_font_montserrat_28, 0xFFFFFF, "PSOC Edge Dashboard");
	lv_obj_align(title, LV_ALIGN_LEFT_MID, 18, 0);

	subtitle = label_create(header, &lv_font_montserrat_14, 0xBFE8E2,
				"DevCon 2026  |  Zephyr + LVGL");
	lv_obj_align(subtitle, LV_ALIGN_RIGHT_MID, -18, 0);

	/* ---- LED cards ---- */
	for (uint8_t i = 0; i < UI_LED_COUNT; i++) {
		led_card_create(scr, i, initial_percent[i]);
	}

	/* ---- Tilt meter ---- */
	tilt_card = panel_create(scr, RIGHT_X, CARD_Y0, RIGHT_W, CARD_H * 2 + CARD_GAP);

	caption = label_create(tilt_card, &lv_font_montserrat_14, C_MUTED, "BOARD TILT");
	lv_obj_align(caption, LV_ALIGN_TOP_MID, 0, 14);

	tilt_arc = lv_arc_create(tilt_card);
	lv_obj_set_size(tilt_arc, ARC_SIZE, ARC_SIZE);
	lv_obj_align(tilt_arc, LV_ALIGN_TOP_MID, 0, 34);
	lv_arc_set_rotation(tilt_arc, 135);
	lv_arc_set_bg_angles(tilt_arc, 0, 270);
	lv_arc_set_range(tilt_arc, 0, 90);
	lv_arc_set_value(tilt_arc, 0);

	/*
	 * The arc is an output, not a control. Without this it steals touch
	 * events from the sliders behind it and the attendee can drag the tilt
	 * reading by hand, which makes the sensor look broken.
	 */
	lv_obj_remove_flag(tilt_arc, LV_OBJ_FLAG_CLICKABLE);
	lv_obj_remove_style(tilt_arc, NULL, LV_PART_KNOB);

	lv_obj_set_style_arc_color(tilt_arc, lv_color_hex(C_BG_DEEP), LV_PART_MAIN);
	lv_obj_set_style_arc_width(tilt_arc, 18, LV_PART_MAIN);
	lv_obj_set_style_arc_rounded(tilt_arc, true, LV_PART_MAIN);

	lv_obj_set_style_arc_color(tilt_arc, lv_color_hex(C_OCEAN_LT), LV_PART_INDICATOR);
	lv_obj_set_style_arc_width(tilt_arc, 18, LV_PART_INDICATOR);
	lv_obj_set_style_arc_rounded(tilt_arc, true, LV_PART_INDICATOR);

	tilt_value_label = label_create(tilt_card, &lv_font_montserrat_40, C_TEXT, "0");
	lv_obj_align_to(tilt_value_label, tilt_arc, LV_ALIGN_CENTER, 0, -6);

	/* ---- Status / raw readout ---- */
	status_card = panel_create(scr, RIGHT_X, CARD_Y0 + 2 * (CARD_H + CARD_GAP), RIGHT_W,
				   CARD_H);

	pitch_label = label_create(status_card, &lv_font_montserrat_18, C_TEXT, "PITCH    --");
	lv_obj_set_pos(pitch_label, 20, 16);

	roll_label = label_create(status_card, &lv_font_montserrat_18, C_TEXT, "ROLL     --");
	lv_obj_set_pos(roll_label, 20, 44);

	status_label = label_create(status_card, &lv_font_montserrat_14, C_MUTED, "starting...");
	lv_obj_set_pos(status_label, 20, 82);
}

void ui_set_tilt(int32_t pitch_mdeg, int32_t roll_mdeg)
{
	/*
	 * Last values actually rendered, in the precision the labels show
	 * (tenths of a degree) rather than raw milli-degrees.
	 *
	 * lv_label_set_text() invalidates unconditionally - it does not compare
	 * against the current text - so calling it every poll repaints all
	 * 832x480 pixels about twenty times a second to redraw characters that
	 * have not changed. Beyond being wasteful, that hands the display
	 * controller a new frame buffer on a cadence unrelated to the panel's
	 * 60 Hz refresh, and the two slowly drift in and out of phase. Guarding
	 * each update keeps the screen static whenever the readings are.
	 */
	static int32_t last_magnitude = INT32_MIN;
	static int32_t last_pitch_tenths = INT32_MIN;
	static int32_t last_roll_tenths = INT32_MIN;

	char buf[32];
	int32_t magnitude;
	int32_t pitch_tenths = pitch_mdeg / 100;
	int32_t roll_tenths = roll_mdeg / 100;

	/*
	 * A single number for the arc: the larger of the two absolute angles.
	 * Summing them would read above 90 for a board tipped on a corner, and
	 * a vector magnitude needs a square root for no visible benefit at this
	 * size.
	 */
	magnitude = MAX(pitch_mdeg < 0 ? -pitch_mdeg : pitch_mdeg,
			roll_mdeg < 0 ? -roll_mdeg : roll_mdeg) / 1000;
	magnitude = CLAMP(magnitude, 0, 90);

	if (magnitude != last_magnitude) {
		last_magnitude = magnitude;

		lv_arc_set_value(tilt_arc, magnitude);

		snprintf(buf, sizeof(buf), "%d", (int)magnitude);
		lv_label_set_text(tilt_value_label, buf);
	}

	/*
	 * Printed as integer degrees plus one decimal rather than via %f: the
	 * default cbprintf build has no floating-point support, so a %f here
	 * renders as a literal "%f" on the panel.
	 */
	if (pitch_tenths != last_pitch_tenths) {
		last_pitch_tenths = pitch_tenths;

		snprintf(buf, sizeof(buf), "PITCH  %4d.%01u deg", (int)(pitch_mdeg / 1000),
			 (unsigned int)((pitch_mdeg < 0 ? -pitch_mdeg : pitch_mdeg) % 1000) / 100);
		lv_label_set_text(pitch_label, buf);
	}

	if (roll_tenths != last_roll_tenths) {
		last_roll_tenths = roll_tenths;

		snprintf(buf, sizeof(buf), "ROLL   %4d.%01u deg", (int)(roll_mdeg / 1000),
			 (unsigned int)((roll_mdeg < 0 ? -roll_mdeg : roll_mdeg) % 1000) / 100);
		lv_label_set_text(roll_label, buf);
	}
}

void ui_set_status(const char *text)
{
	lv_label_set_text(status_label, text);
}
```
